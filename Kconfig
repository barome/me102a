## Kconfig
```kconfig
#
# For a description of the syntax of this configuration file,
# see Documentation/kbuild/kconfig-language.txt.
#
mainmenu "Linux/$ARCH $KERNELVERSION Kernel Configuration"

config SRCARCH
	string
	option env="SRCARCH"

config TRACE_LOG_PRINTK
	bool "Print trace log while selected"
	default n

source "arch/$SRCARCH/Kconfig"
```

## drivers/input/sensors/hall/Kconfig
```kconfig
#
# hall sensor drivers configuration
#

menuconfig HALL_DEVICE
	bool "hall sensor device support"
	default n

if HALL_DEVICE
 config HALL_SENSOR
 bool "hall sensor"
 default n
 
endif
```

## drivers/input/thermal/Kconfig
```kconfig
#
# temperature sensor drivers configuration
#

menuconfig THERMAL_DEVICE
	bool "thermal_sensor device support"	
	help
	  Enable this to be able to choose the drivers for controlling the
	  thermal_sensor on some platforms, for example on PDAs.

if THERMAL_DEVICE

config THERMAL_US5004
  tristate "us5004"
  depends on I2C
  help	 
	To have support for your specific temperature sensor you will have to
	  select the proper drivers which depend on this option.
	  
endif
```

## drivers/media/video/mt9m114/Kconfig
```kconfig
#
#  Fujitsu camera isp chip: m6moj.
#
config SOC_CAMERA_MT9M114
	tristate "mt9m114 support"
	depends on SOC_CAMERA && I2C
	help
	  This driver supports MT9M114 cameras from
	  Micron/Aptina
```

## drivers/misc/mpu6500/Kconfig
```kconfig
#
# mpu6500 drivers configuration
#

menuconfig MPU6500_DEVICE
	tristate "mpu6500 support"
	
if MPU6500_DEVICE

source "drivers/misc/mpu6500/accel/Kconfig"
source "drivers/misc/mpu6500/compass/Kconfig"
source "drivers/misc/mpu6500/mpu/Kconfig"
source "drivers/misc/mpu6500/lsensor/Kconfig"
#source "drivers/misc/mpu6500/lsensor/Kconfig"
#source "drivers/misc/mpu6500/psensor/Kconfig"
#source "drivers/misc/mpu6500/temperature/Kconfig"
#source "drivers/misc/mpu6500/pressure/Kconfig"


endif
```

## drivers/misc/mpu6500/accel/Kconfig
```kconfig
#
# gsensor drivers configuration
#

menuconfig INV_ACCEL
	bool "inv accel device support"
	help
	  Enable this to be able to choose the drivers for controlling the
	  g_sensor on some platforms, for example on PDAs.

if INV_ACCEL
config INV_ACCEL_BMA250
    tristate "Invensense Bosch BMA250 accelerometer input device driver"
    depends on I2C && SYSFS && INPUT
    default n
    help
      This driver supports the Bosch BMA250 accelerometer.
      This driver can be built as a module. The module will be called
      inv-bma250.
endif
```

## drivers/misc/mpu6500/compass/Kconfig
```kconfig
#
# compass drivers configuration
#

menuconfig INV_COMPASS
	bool "inv compass device support"
	help
	  Enable this to be able to choose the drivers for controlling the
	  g_sensor on some platforms, for example on PDAs.

if INV_COMPASS
config INV_COMPASS_YAS53X
    tristate "Invensense Yamaha YAS530/YAS532 compass input device driver"
    depends on I2C && SYSFS && INPUT
    default n
    help
      This driver supports the Yamaha YAS530/YAS532 compass device .
      This driver can be built as a module. The module will be called
      inv-yas53x.

config INV_COMPASS_AK89XX
    tristate "Invensense AKM AK8975/AK8972/AK8963 compass input device drivers"
    depends on I2C && SYSFS && INPUT
    default n
    help
      This driver supports the AKM AK8975/AK8972/AK8963 compass devices.
      This driver can be built as a module. The module will be called
      inv-ak89xx.

endif
```

## drivers/misc/mpu6500/lsensor/Kconfig
```kconfig
#
# light sensor drivers configuration
#

menuconfig INV_LIGHT
	bool "light sensor device support"
	help
	  Enable this to be able to choose the drivers for controlling the
	  light sensor on some platforms, for example on PDAs.

if INV_LIGHT
config INV_LIGHT_US5152
    tristate "light sensor us5152 driver"
    depends on I2C && SYSFS && INPUT
    default n
endif
```

## drivers/misc/mpu6500/mpu/Kconfig
```kconfig
#
# gyro drivers configuration
#

menuconfig INV_GYRO
	bool "Invensense GYRO devices"
	depends on I2C && SYSFS && INPUT
	default n
	help
	  This driver supports the Invensense GYRO devices.
	  This driver can be built as a module. The module will be called
	  inv-mpu.

if INV_GYRO
config INV_TESTING
	boolean "Invensense GYRO Testing Information"
	depends on INV_GYRO
	default n
	help
	  This flag enables display of additional testing information from
	  the Invensense GYRO driver.
endif
```

## drivers/net/wireless/rtl8723BS/Kconfig
```kconfig
config RTL8723AS
    bool "Realtek 8723A SDIO or SPI WiFi"
    ---help---
      Help message of RTL8723AS


config RTL8723BS
	bool "Realtek 8723B SDIO or SPI WiFi"
	---help---
	  Help message of RTL8723BS

config WLAN_SDIO
	bool "Enable SDIO interface for Realtek"
	depends on RTL8723AS || RTL8723BS
	default n
	---help---
	  Use memory preallocated in platform
```
